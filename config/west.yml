## config/west.yml
```yaml
manifest:
  remotes:
    - name: zmkfirmware
      url-base: https://github.com/zmkfirmware
    # - name: art-display
    #   url-base: https://github.com/PowerAbuser
    - name: m165437 #new entry
      url-base: https://github.com/M165437 #new entry
      #  - name: gpeye
      #    url-base: https://github.com/GPeye
    - name: mctechnology17
      url-base: https://github.com/mctechnology17

  projects:
    # - name: mario-peripheral-animation
    #   remote: gpeye
    #    revision: main
    - name: eyelash_sofle
      url: https://github.com/a741725193/zmk-sofle
      revision: main
    - name: zmk
      remote: zmkfirmware
      revision: v0.3.0
      import: app/west.yml
    - name: zmk-nice-oled
      remote: mctechnology17
      revision: main
    # - name: zmk-sofle
    #   remote: art-display
    #   revision: main
  self:
    path: boards
```
